## br2-external/configs/linux-dev_defconfig
```kconfig
BR2_x86_64=y
BR2_SYSTEM_DHCP="eth0"
BR2_ROOTFS_OVERLAY="$(BR2_EXTERNAL_LINUX_DEV_PATH)/common/overlay $(BR2_EXTERNAL_LINUX_DEV_PATH)/user/overlay"
BR2_PACKAGE_OPENSSH=y
BR2_TARGET_ROOTFS_EXT2=y
BR2_TARGET_ROOTFS_EXT2_4=y
```
